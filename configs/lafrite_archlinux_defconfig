## configs/lafrite_archlinux_defconfig
```kconfig
BR2_aarch64=y
BR2_KERNEL_HEADERS_5_7=y
BR2_USERLAND_ARCHLINUX=y
BR2_PACKAGE_SKELETON_ARCHLINUX_PACKAGES="base iproute2 vim"
BR2_ROOTFS_OVERLAY="board/librecomputer/lafrite/overlay/"
BR2_ROOTFS_POST_IMAGE_SCRIPT="support/scripts/genimage.sh"
BR2_ROOTFS_POST_SCRIPT_ARGS="-c board/librecomputer/lafrite/genimage.cfg"
BR2_LINUX_KERNEL=y
BR2_LINUX_KERNEL_USE_ARCH_DEFAULT_CONFIG=y
BR2_LINUX_KERNEL_DTS_SUPPORT=y
BR2_LINUX_KERNEL_INTREE_DTS_NAME="amlogic/meson-gxl-s805x-libretech-ac"
BR2_LINUX_KERNEL_INSTALL_TARGET=y
# BR2_PACKAGE_BUSYBOX is not set
BR2_TARGET_ROOTFS_EXT2=y
BR2_TARGET_ROOTFS_EXT2_4=y
BR2_TARGET_ROOTFS_EXT2_SIZE="8G"
# BR2_TARGET_ROOTFS_TAR is not set
BR2_PACKAGE_HOST_GENIMAGE=y
```

## configs/pc_x86_64_bios_qt5we_defconfig
```kconfig
# Architecture
BR2_x86_64=y

# Toolchain, required for eudev (to autoload drivers) and Qt
BR2_TOOLCHAIN_BUILDROOT_GLIBC=y
BR2_TOOLCHAIN_BUILDROOT_CXX=y
BR2_TOOLCHAIN_BUILDROOT_WCHAR=y

# System
BR2_TARGET_GENERIC_GETTY_PORT="tty1"
BR2_ROOTFS_DEVICE_CREATION_DYNAMIC_EUDEV=y

# Required tools to create bootable media
BR2_PACKAGE_HOST_GENIMAGE=y

# Bootloader
BR2_TARGET_GRUB2=y

# Filesystem / image
BR2_TARGET_ROOTFS_EXT2=y
BR2_TARGET_ROOTFS_EXT2_4=y
BR2_TARGET_ROOTFS_EXT2_SIZE="520M"
# BR2_TARGET_ROOTFS_TAR is not set
BR2_ROOTFS_POST_IMAGE_SCRIPT="board/pc/post-image.sh support/scripts/genimage.sh"
BR2_ROOTFS_POST_SCRIPT_ARGS="-c board/pc/genimage-bios.cfg"

# Linux headers same as kernel, a 4.13 series
BR2_PACKAGE_HOST_LINUX_HEADERS_CUSTOM_4_13=y

# Kernel
BR2_LINUX_KERNEL=y
BR2_LINUX_KERNEL_CUSTOM_VERSION=y
BR2_LINUX_KERNEL_CUSTOM_VERSION_VALUE="4.13.8"
BR2_LINUX_KERNEL_USE_CUSTOM_CONFIG=y
BR2_LINUX_KERNEL_CUSTOM_CONFIG_FILE="board/pc/linux.config"
BR2_LINUX_KERNEL_INSTALL_TARGET=y

# Firmware
BR2_PACKAGE_LINUX_FIRMWARE=y
BR2_PACKAGE_LINUX_FIRMWARE_I915=y
BR2_PACKAGE_LINUX_FIRMWARE_ATHEROS_9170=y
BR2_PACKAGE_LINUX_FIRMWARE_ATHEROS_9271=y
BR2_PACKAGE_LINUX_FIRMWARE_IWLWIFI_3160=y
BR2_PACKAGE_LINUX_FIRMWARE_IWLWIFI_3168=y
BR2_PACKAGE_LINUX_FIRMWARE_IWLWIFI_5000=y
BR2_PACKAGE_LINUX_FIRMWARE_IWLWIFI_6000G2A=y
BR2_PACKAGE_LINUX_FIRMWARE_IWLWIFI_6000G2B=y
BR2_PACKAGE_LINUX_FIRMWARE_IWLWIFI_7260=y
BR2_PACKAGE_LINUX_FIRMWARE_IWLWIFI_7265D=y
BR2_PACKAGE_LINUX_FIRMWARE_IWLWIFI_8000C=y
BR2_PACKAGE_LINUX_FIRMWARE_IWLWIFI_8265=y
BR2_PACKAGE_LINUX_FIRMWARE_RALINK_RT73=y
BR2_PACKAGE_LINUX_FIRMWARE_RALINK_RT2XX=y
BR2_PACKAGE_LINUX_FIRMWARE_RTL_8169=y
BR2_PACKAGE_LINUX_FIRMWARE_RTL_81XX=y
BR2_PACKAGE_LINUX_FIRMWARE_RTL_87XX=y
BR2_PACKAGE_LINUX_FIRMWARE_RTL_88XX=y

# Packages
#
# Use connman so that networking setup is simpler, via connmanctl tool
# acpid is for seamless power button support
BR2_PACKAGE_ACPID=y
BR2_PACKAGE_CA_CERTIFICATES=y
BR2_PACKAGE_LIBDRM_RADEON=y
BR2_PACKAGE_LIBDRM_NOUVEAU=y
BR2_PACKAGE_CONNMAN=y
BR2_PACKAGE_CONNMAN_CLIENT=y
BR2_PACKAGE_CONNMAN_WIFI=y
BR2_PACKAGE_KMSCUBE=y
BR2_PACKAGE_MESA3D_DEMOS=y
BR2_PACKAGE_FBTERM=y
BR2_PACKAGE_MESA3D=y
BR2_PACKAGE_MESA3D_DRI_DRIVER_SWRAST=y
BR2_PACKAGE_MESA3D_DRI_DRIVER_I915=y
BR2_PACKAGE_MESA3D_DRI_DRIVER_I965=y
BR2_PACKAGE_MESA3D_OSMESA=y
BR2_PACKAGE_MESA3D_OPENGL_EGL=y
BR2_PACKAGE_MESA3D_OPENGL_ES=y
BR2_PACKAGE_MESA3D_OPENGL_TEXTURE_FLOAT=y
BR2_PACKAGE_NTP=y
BR2_PACKAGE_QT5=y
BR2_PACKAGE_QT53D=y
BR2_PACKAGE_QT5BASE_EXAMPLES=y
BR2_PACKAGE_QT5BASE_GIF=y
BR2_PACKAGE_QT5BASE_JPEG=y
BR2_PACKAGE_QT5BASE_PNG=y
BR2_PACKAGE_QT5CANVAS3D=y
BR2_PACKAGE_QT5CHARTS=y
BR2_PACKAGE_QT5ENGINIO=y
BR2_PACKAGE_QT5GRAPHICALEFFECTS=y
BR2_PACKAGE_QT5IMAGEFORMATS=y
BR2_PACKAGE_QT5LOCATION=y
BR2_PACKAGE_QT5MULTIMEDIA=y
BR2_PACKAGE_QT5SCRIPT=y
BR2_PACKAGE_QT5SCXML=y
BR2_PACKAGE_QT5SENSORS=y
BR2_PACKAGE_QT5SERIALBUS=y
BR2_PACKAGE_QT5TOOLS=y
BR2_PACKAGE_QT5VIRTUALKEYBOARD=y
BR2_PACKAGE_QT5WAYLAND=y
BR2_PACKAGE_QT5WEBKIT=y
BR2_PACKAGE_QT5WEBKIT_EXAMPLES=y
BR2_PACKAGE_QT5WEBENGINE=y
BR2_PACKAGE_QT5WEBENGINE_PROPRIETARY_CODECS=y
```

## configs/qemu_aarch64_virt_debian_defconfig
```kconfig
# Architecture
BR2_aarch64=y
BR2_cortex_a53=y

# Filesystem
BR2_TARGET_ROOTFS_EXT2=y
BR2_TARGET_ROOTFS_EXT2_4=y
BR2_TARGET_ROOTFS_EXT2_SIZE="8G"
# BR2_TARGET_ROOTFS_TAR is not set
BR2_USERLAND_DEBIAN=y
# BR2_PACKAGE_BUSYBOX is not set

# Image
BR2_ROOTFS_POST_IMAGE_SCRIPT="board/qemu/post-image.sh"
BR2_ROOTFS_POST_SCRIPT_ARGS="$(BR2_DEFCONFIG)"

# Linux headers same as kernel, a 5.4 series
BR2_PACKAGE_HOST_LINUX_HEADERS_CUSTOM_5_4=y

# Kernel
BR2_LINUX_KERNEL=y
BR2_LINUX_KERNEL_CUSTOM_VERSION=y
BR2_LINUX_KERNEL_CUSTOM_VERSION_VALUE="5.4.35"
BR2_LINUX_KERNEL_USE_CUSTOM_CONFIG=y
BR2_LINUX_KERNEL_CUSTOM_CONFIG_FILE="board/qemu/aarch64-virt/linux.config"
BR2_LINUX_KERNEL_NEEDS_HOST_OPENSSL=y
```

## configs/qemu_x86_64_archlinux_base_defconfig
```kconfig
# Architecture
BR2_x86_64=y

# System
BR2_SYSTEM_DHCP="eth0"
BR2_TARGET_GENERIC_GETTY_PORT="tty1"

# Filesystem
BR2_TARGET_ROOTFS_EXT2=y
BR2_TARGET_ROOTFS_EXT2_SIZE="2G"
# BR2_TARGET_ROOTFS_TAR is not set
BR2_USERLAND_ARCHLINUX=y
```

## configs/qemu_x86_64_debian_defconfig
```kconfig
# Architecture
BR2_x86_64=y

# Filesystem
BR2_TARGET_ROOTFS_EXT2=y
BR2_TARGET_ROOTFS_EXT2_SIZE="2G"
# BR2_TARGET_ROOTFS_TAR is not set
BR2_USERLAND_DEBIAN=y
# BR2_PACKAGE_BUSYBOX is not set

# Image
BR2_ROOTFS_POST_IMAGE_SCRIPT="board/qemu/post-image.sh"
BR2_ROOTFS_POST_SCRIPT_ARGS="$(BR2_DEFCONFIG)"
```

## package/arch-install-scripts/Config.in.host
```kconfig
config BR2_PACKAGE_HOST_ARCH_INSTALL_SCRIPTS
	bool "host arch-install-scripts"
	help
	  This is a small suite of scripts aimed at automating some menial
	  tasks when installing Arch Linux.

	  https://git.archlinux.org/arch-install-scripts.git/
```

## package/archlinux-keyring/Config.in.host
```kconfig
config BR2_PACKAGE_HOST_ARCHLINUX_KEYRING
	bool "host archlinux-keyring"
	help
	  Arch Linux PGP keyring
	  
	  https://git.archlinux.org/archlinux-keyring.git/
```

## package/cryptopp/Config.in
```kconfig
config BR2_PACKAGE_CRYPTOPP
	bool "cryptopp"
	depends on BR2_INSTALL_LIBSTDCPP
	help
	  Crypto++ Library is a free C++ class library of cryptographic schemes.

	  https://www.cryptopp.com/
```

## package/debootstrap/Config.in.host
```kconfig
config BR2_DEBOOTSTRAP_HOST_ARCH_INSTALL_SCRIPTS
	bool "host debootstrap"
	help
	  debootstrap is used to create a Debian base system from
	  scratch, without requiring the availability of dpkg or apt.
	  It does this by  downloading .deb files from a mirror site,
	  and carefully unpacking them  into a directory which can
	  eventually be chrooted into.

	  https://salsa.debian.org/installer-team/debootstrap
```

## package/dnf/Config.in.host
```kconfig
config BR2_PACKAGE_HOST_DNF
	bool "host dnf"
	help
	  Utility that allows users to manage packages on their systems.
	  It supports RPMs, modules and comps groups & environments.

	  https://fedoraproject.org/wiki/DNF
```

## package/libcomps/Config.in.host
```kconfig
config BR2_PACKAGE_HOST_LIBCOMPS
	bool "host libcomps"
	SELECT BR2_PACKAGE_HOST_EXPAT
	SELECT BR2_PACKAGE_HOST_LIBXML2
	SELECT BR2_PACKAGE_HOST-ZLIB
	help
	  Libcomps is library for structure-like manipulation with content
	  of comps XML files. Supports read/write XML file, structure(s)
	  modification.

	  https://fedoraproject.org/wiki/DNF
	  https://github.com/rpm-software-management/libcomps
```

## package/libdnf/Config.in.host
```kconfig
config BR2_PACKAGE_HOST_LIBDNF
	bool "host libdnf"
	help
	  A Library providing simplified C and Python API to libsolv.

	  https://fedoraproject.org/wiki/DNF
	  https://github.com/rpm-software-management/libdnf
```

## package/libnspr/Config.in.host
```kconfig
config BR2_PACKAGE_HOST_LIBNSPR
	bool "host libnspr"
	help
	  NSPR is the Netscape Portable Runtime library which provides
	  a platform-neutral API for system level and libc like
	  functions. The library is used by the Mozilla project as well
	  as others.

	  http://www.mozilla.org/projects/nspr/
```

## package/librepo/Config.in.host
```kconfig
config BR2_PACKAGE_HOST_LIBREPO
	bool "host librepo"
	select BR2_PACKAGE_HOST_LIBGLIB2
	select BR2_PACKAGE_HOST_LIBXML2
	select BR2_PACKAGE_HOST_OPENSSL
	select BR2_PACKAGE_HOST_ZCHUNK
	help
	  A library providing C and Python (libcURL like) API to downloading
	  repository metadata. 

	  https://fedoraproject.org/wiki/DNF
	  https://github.com/rpm-software-management/librepo
```

## package/libsolv/Config.in.host
```kconfig
config BR2_PACKAGE_HOST_LIBSOLV
	bool "host libsolv"
	select BR2_PACKAGE_HOST-BZIP2
	select BR2_PACKAGE_HOST_LIBXML2
 	select BR2_PACKAGE_HOST_LZMA
	select BR2_PACKAGE_HOST_ZCHUNK
 	select BR2_PACKAGE_HOST_ZSTD
	help
	  Library for solving packages.

	  https://github.com/openSUSE/libsolv
```

## package/pacman-mirrorlist/Config.in.host
```kconfig
config BR2_PACKAGE_HOST_PACMAN_MIRRORLIST
	bool "host pacman-mirrorlist"
	help
	  Arch Linux mirror list for use by pacman.

	  x86_64: https://www.archlinux.org/mirrorlist/
	  aarch64: http://www.archlinuxarm.org/about/mirrors
```

## package/pacman/Config.in.host
```kconfig
config BR2_PACKAGE_HOST_PACMAN
	bool "host pacman"
	select BR2_PACKAGE_LIBARCHIVE
	help
	  A library-based package manager with dependency support.

	  https://www.archlinux.org/pacman/
```

## package/qt5/qt5webkit-examples/Config.in
```kconfig
config BR2_PACKAGE_QT5WEBKIT_EXAMPLES
	bool "qt5webkit-examples"
	depends on BR2_PACKAGE_QT5WEBKIT
	select BR2_PACKAGE_QT5BASE_SQLITE_SYSTEM # flickrview, youtubeview
	help
	  Qt is a cross-platform application and UI framework for
	  developers using C++.

	  This package contains examples for the qt5webkit module.

	  http://qt.io
```

## package/qt5/qt5webkit/Config.in
```kconfig
config BR2_PACKAGE_QT5WEBKIT
	bool "qt5webkit"
	depends on !BR2_STATIC_LIBS
	depends on BR2_PACKAGE_QT5_JSCORE_AVAILABLE
	depends on BR2_HOST_GCC_AT_LEAST_4_8 # icu
	depends on BR2_TOOLCHAIN_GCC_AT_LEAST_4_8 # icu
	depends on BR2_TOOLCHAIN_HAS_THREADS # gstreamer1
	depends on BR2_USE_WCHAR # gstreamer1
	depends on BR2_USE_MMU # gstreamer1
	depends on !BR2_BINFMT_FLAT # icu
	# assumes a FPU is available on MIPS
	depends on !BR2_MIPS_SOFT_FLOAT
	select BR2_PACKAGE_GSTREAMER1
	select BR2_PACKAGE_GST1_PLUGINS_GOOD
	select BR2_PACKAGE_GST1_PLUGINS_GOOD_PLUGIN_SPECTRUM
	select BR2_PACKAGE_JPEG
	select BR2_PACKAGE_LIBPNG
	select BR2_PACKAGE_LIBXSLT
	select BR2_PACKAGE_QT5BASE
	select BR2_PACKAGE_QT5BASE_ICU
	select BR2_PACKAGE_QT5BASE_GUI
	select BR2_PACKAGE_QT5BASE_WIDGETS
	select BR2_PACKAGE_QT5DECLARATIVE
	select BR2_PACKAGE_QT5LOCATION
	select BR2_PACKAGE_QT5SENSORS
	select BR2_PACKAGE_QT5WEBCHANNEL
	select BR2_PACKAGE_SQLITE
	select BR2_PACKAGE_XLIB_LIBXEXT if BR2_PACKAGE_QT5BASE_XCB
	select BR2_PACKAGE_XLIB_LIBXRENDER if BR2_PACKAGE_QT5BASE_XCB
	depends on BR2_HOST_GCC_AT_LEAST_4_8 # icu
	depends on BR2_INSTALL_LIBSTDCPP # icu
	depends on BR2_USE_WCHAR # icu
	depends on BR2_TOOLCHAIN_GCC_AT_LEAST_4_8 # icu
	depends on BR2_TOOLCHAIN_HAS_THREADS # icu
	help
	  Qt is a cross-platform application and UI framework for
	  developers using C++.

	  The Qt WebKit module provides the WebView API, which
	  allows QML applications to render regions of dynamic
	  web content.

	  This package has been removed from the official release
	  packages since Qt5.6.0, but it is still available for users
	  to build it from source. This is useful for platforms
	  without GPU since the successor (QtWebEngine) requires
	  OpenGL support.

	  http://doc.qt.io/archives/qt-5.5/qtwebkit-index.html

comment "qt5webkit needs a toolchain w/ dynamic library, gcc >= 4.8, host gcc >= 4.8"
	depends on BR2_STATIC_LIBS || !BR2_TOOLCHAIN_GCC_AT_LEAST_4_8 || \
		!BR2_HOST_GCC_AT_LEAST_4_8
	depends on BR2_PACKAGE_QT5_JSCORE_AVAILABLE
	depends on !BR2_BINFMT_FLAT
	depends on !BR2_MIPS_SOFT_FLOAT
```

## package/qtwebbrowser/Config.in
```kconfig
config BR2_PACKAGE_QTWEBBROWSER
	bool "qtwebbrowser"
	depends on BR2_PACKAGE_QT5WEBENGINE
	depends on BR2_PACKAGE_QT5VIRTUALKEYBOARD
	help
	  The Qt WebBrowser (codename Roadtrip) is a browser for
	  embedded devices developed using the capabilities of Qt and
	  Qt WebEngine. Using recent Chromium, it features up-to-date
	  HTML technologies behind a minimal but slick touch-friendly
	  user interface written in Qt Quick.

	  http://doc.qt.io/QtWebBrowser/
```

## package/skeleton-archlinux/Config.in
```kconfig
config BR2_PACKAGE_SKELETON_ARCHLINUX_ARCH_SUPPORTS
	bool
	default y if BR2_x86_64 || BR2_aarch64

config BR2_PACKAGE_SKELETON_ARCHLINUX
	bool
	depends on BR2_PACKAGE_SKELETON_ARCHLINUX_ARCH_SUPPORTS
	select BR2_PACKAGE_HAS_SKELETON
	select BR2_PACKAGE_HOST_ARCHLINUXARM_KEYRING if BR2_aarch64
	select BR2_PACKAGE_HOST_ARCHLINUX_KEYRING
	select BR2_PACKAGE_HOST_ARCHLINUX_PACMAN
	select BR2_PACKAGE_HOST_ARCHLINUX_PACMAN_MIRRORLIST
	select BR2_PACKAGE_HOST_FAKECHROOT
	select BR2_PACKAGE_HOST_FAKECHROOT
	select BR2_PACKAGE_HOST_FAKEROOT
	select BR2_PACKAGE_HOST_FAKEROOT
	select BR2_PACKAGE_SKELETON_INIT_COMMON

config BR2_PACKAGE_PROVIDES_SKELETON
	default "skeleton-archlinux" if BR2_PACKAGE_SKELETON_ARCHLINUX
```

## package/skeleton-debian/Config.in
```kconfig
config BR2_PACKAGE_SKELETON_DEBIAN
	bool
	select BR2_PACKAGE_HAS_SKELETON
	select BR2_PACKAGE_HOST_FAKECHROOT
	select BR2_PACKAGE_HOST_FAKEROOT
	select BR2_PACKAGE_SKELETON_INIT_COMMON

config BR2_PACKAGE_PROVIDES_SKELETON
	default "skeleton-debian" if BR2_PACKAGE_SKELETON_DEBIAN
```

## package/skeleton-fedora/Config.in
```kconfig
config BR2_PACKAGE_SKELETON_FEDORA_ARCH_SUPPORTS
	bool
	default y if BR2_x86_64 || BR2_aarch64

config BR2_PACKAGE_SKELETON_FEDORA
	bool
	depends on BR2_PACKAGE_SKELETON_FEDORA_ARCH_SUPPORTS
	select BR2_PACKAGE_HAS_SKELETON
	select BR2_PACKAGE_HOST_FAKECHROOT
	select BR2_PACKAGE_HOST_FAKECHROOT
	select BR2_PACKAGE_HOST_FAKEROOT
	select BR2_PACKAGE_HOST_FAKEROOT
	select BR2_PACKAGE_SKELETON_INIT_COMMON

config BR2_PACKAGE_PROVIDES_SKELETON
	default "skeleton-fedora" if BR2_PACKAGE_SKELETON_FEDORA
```

## package/zchunk/Config.in.host
```kconfig
config BR2_PACKAGE_HOST_ZCHUNK
	bool "host zchunk"
	select BR2_PACKAGE_HOST_LIBCURL
	help
	  A file format that allows easy deltas while maintaining
	  good compression.

	  https://github.com/zchunk/zchunk
```
